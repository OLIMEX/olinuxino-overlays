/dts-v1/;
/plugin/;

/ {
	compatible = "olimex,stm32mp1xx-olinuxino-som",
		     "olimex,stm32mp1xx-olinuxino-lime";
	description = "Enable USART3 port";

	fragment@0 {
		target-path = "/aliases";
		__overlay__ {
			serial3 = "/soc/serial@4000f000";
		};
	};

	fragment@1 {
		target = <&usart3>;
		 __overlay__ {
			pinctrl-names = "default", "sleep", "idle";
			pinctrl-0 = <&usart3_pins_b>;
			pinctrl-1 = <&usart3_sleep_pins_b>;
			pinctrl-2 = <&usart3_idle_pins_b>;

			status = "okay";
		};
	};
};
