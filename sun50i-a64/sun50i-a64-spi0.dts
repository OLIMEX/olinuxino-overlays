/dts-v1/;
/plugin/;

/ {
	compatible = "allwinner,sun50i-a64",
		     "olimex,a64-olinuxino";
	description = "Enable SPI0 bus";

	fragment@0 {
		target = <&spi0>;
		__overlay__ {
			status = "okay";
		};
	};
};
