/dts-v1/;
/plugin/;

/ {
	compatible = "allwinner,sun50i-a64",
		     "olimex,a64-olinuxino";
	description = "Enable spidev on SPI1 !!Multiplexed with LCD D2-D5";

	fragment@0 {
		target = <&spi1>;
		__overlay__ {

			spidev@0 {
				compatible = "spidev";
				reg = <0>;
				spi-max-frequency = <10000000>;
				status = "okay";
			};
		};
	};
};
