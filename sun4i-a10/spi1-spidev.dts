/dts-v1/;
/plugin/;

/ {
	compatible = "allwinner,sun4i-a10";
	description = "Enable spidev on SPI1";

	fragment@0 {
		target = <&spi1>;
		__overlay__ {

			spidev@0 {
				compatible = "spidev";
				reg = <0>;
				spi-max-frequency = <10000000>;
				status = "okay";
			};
		};
	};
};
