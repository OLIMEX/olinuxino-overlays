/dts-v1/;
/plugin/;

/ {
	compatible = "allwinner,sun4i-a10";
	description = "Enable CAN controller";

	fragment@0 {
		target = <&pio>;
		__overlay__ {
			can_ph_pins: can-ph-pins {
				pins = "PH20", "PH21";
				function = "can";
			};
		};
	};

	fragment@1 {
		target = <&can0>;
		__overlay__ {
			pinctrl-names = "default";
			pinctrl-0 = <&can_ph_pins>;
			status = "okay";
		};
	};
};
