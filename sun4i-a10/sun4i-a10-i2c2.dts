/dts-v1/;
/plugin/;

/ {
	compatible = "allwinner,sun4i-a10";
	description = "Enable I2C2 bus";

	fragment@0 {
		target = <&pio>;
		__overlay__ {
			i2c2_pins: i2c2-pins {
				pins = "PB20", "PB21";
				function = "i2c2";
			};
		};
	};

	fragment@1 {
		target = <&i2c2>;
		__overlay__ {
			pinctrl-names = "default";
			pinctrl-0 = <&i2c2_pins>;
			status = "okay";
		};
	};
};
