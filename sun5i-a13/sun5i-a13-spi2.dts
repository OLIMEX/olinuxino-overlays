/dts-v1/;
/plugin/;

/ {
	compatible = "allwinner,sun5i-a13";
	description = "Enable SPI1 bus";

	fragment@0 {
		target-path = "/aliases";
		__overlay__ {
			spi2 = "/soc/spi@1c17000";
		};
	};

	fragment@1 {
		target = <&spi2>;
		__overlay__ {
			pinctrl-names = "default";
			pinctrl-0 = <&spi2_pe_pins>, <&spi2_cs0_pe_pin>;
			status = "okay";
		};
	};
};
