/dts-v1/;
/plugin/;

/ {
compatible = "allwinner,sun5i-a13";
description = "Enable VGA  with 1024x768 resolution";

fragment@0 {
 target-path = "/panel"; /* or target-path */
	 __overlay__ {
		compatible = "olimex,olinuxino-vga-1024x768";
	};
 }; 

};
