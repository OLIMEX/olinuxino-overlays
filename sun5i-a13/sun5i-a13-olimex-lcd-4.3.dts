/dts-v1/;
/plugin/;

/ {
compatible = "allwinner,sun5i-a13";
description = "LCD-OLinuXino-4.3TS 480x272 panel w/wo resistive TS and analog interface";

fragment@0 {
 target-path = "/panel"; /* or target-path */
	 __overlay__ {
		compatible = "olimex,lcd-olinuxino-4.3";
	};
 }; 

};
