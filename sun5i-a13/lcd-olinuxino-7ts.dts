/dts-v1/;
/plugin/;

/ {
compatible = "allwinner,sun5i-a13";
description = "LCD-OLinuXino-7TS 800x480 panel with resistive TS and analog interface";

fragment@0 {
 target-path = "/panel"; /* or target-path */
	 __overlay__ {
		compatible = "olimex,lcd-olinuxino-7";
	};
 }; 

};
