/dts-v1/;
/plugin/;

/ {
	compatible = "allwinner,sun5i-a13";
	description = "Enable spidev on SPI2";

	fragment@0 {
		target = <&spi2>;
		__overlay__ {

			spidev@0 {
				compatible = "spidev";
				reg = <0>;
				spi-max-frequency = <10000000>;
				status = "okay";
			};
		};
	};
};
