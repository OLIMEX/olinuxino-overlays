/dts-v1/;
/plugin/;

/ {
	compatible = "allwinner,sun5i-a13";
	description = "Enable I2C2 bus";

	fragment@0 {
		target-path = "/aliases";
		__overlay__ {
			i2c2 = "/soc@1c00000/i2c@1c2b400";
		};
	};

	fragment@1 {
		target = <&i2c2>;
		__overlay__ {
			status = "okay";
		};
	};
};
