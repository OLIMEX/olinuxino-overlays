/dts-v1/;
/plugin/;

/ {
	compatible = "olimex,a20-olimex-som204-evb",
		     "olimex,a20-olimex-som204-evb-emmc";
	description = "Enable ATECC508A crypto module";

	fragment@0 {
		target = <&i2c2>;
		__overlay__ {
			crypto: atecc508a@60 {
				compatible = "atmel,atecc508a";
				reg = <0x60>;
			};
		};
	};
};
