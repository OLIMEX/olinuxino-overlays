/dts-v1/;
/plugin/;

/ {
	compatible = "olimex,a20-olimex-som204-evb",
		     "olimex,a20-olimex-som204-evb-emmc";
	description = "Goodix GT928 CTS controller on I2C2 bus";

	fragment0 {
		target = <&i2c2>;
		__overlay__ {
			gt928@14 {
				compatible = "goodix,gt928";
				reg = <0x14>;

				interrupt-parent = <&pio>;
				interrupts = <7 2 2>;		/* PH2: IRQ_TYPE_EDGE_FALLING */

				irq-gpios = <&pio 7 2 0>;	/* PH2 */
				reset-gpios = <&pio 8 1 0>;	/* PI1: GPIO_ACTIVE_HIGH */
			};
		};
	};
};
