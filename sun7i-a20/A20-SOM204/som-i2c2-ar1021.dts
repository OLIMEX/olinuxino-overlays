/dts-v1/;
/plugin/;

/ {
	compatible = "olimex,a20-olimex-som204-evb",
		     "olimex,a20-olimex-som204-evb-emmc";
	description = "Microchip AR1021 CTS controller on I2C2 bus";

	fragment0 {
		target = <&i2c2>;
		__overlay__ {
			ar1021: ar1021@4d {
				#address-cells = <1>;
				#size-cells = <0>;
				compatible = "microchip,ar1021-i2c";
				reg = <0x4d>;
				interrupt-parent = <&pio>;
                                interrupts = <7 2 4>;          /* PH2: IRQ_TYPE_LEVEL_HIGH */
				touchscreen-inverted-y;
			};
		};
	};
};
