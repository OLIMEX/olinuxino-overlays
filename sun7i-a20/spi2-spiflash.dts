/dts-v1/;
/plugin/;

/ {
	compatible = "allwinner,sun7i-a20";
	description = "Enable SPI Flash on SPI2";

	fragment@0 {
		target = <&spi2>;
		__overlay__ {

			spi-nor@0 {
				compatible = "jedec,spi-nor";
				reg = <0>;
				spi-max-frequency = <10000000>;
				status = "okay";
			};
		};
	};
};
