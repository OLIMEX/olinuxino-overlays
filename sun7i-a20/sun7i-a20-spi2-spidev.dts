/dts-v1/;
/plugin/;

/ {
	compatible = "allwinner,sun7i-a20";
	description = "Enable spidev on SPI2";

	fragment@0 {
		target = <&spi2>;
		__overlay__ {
			#address-cells = <1>;
			#size-cells = <0>;
			spidev@0 {
				compatible = "spidev";
				reg = <0>;
				spi-max-frequency = <1000000>;
				status = "okay";
			};
		};
	};
};
