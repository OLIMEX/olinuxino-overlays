/dts-v1/;
/plugin/;

/ {
	compatible = "allwinner,sun7i-a20";
	description = "STMP1(A13)-SOM-EVB: eMMC on the flash module (MMC2)";

	fragment@0 {
		target = <&mmc2>;
		__overlay__ {
			#address-cells = <1>;
			#size-cells = <0>;
			pinctrl-names = "default";
			pinctrl-0 = <&mmc2_pins>;
			vmmc-supply = <&reg_vcc3v3>;
			vqmmc-supply = <&reg_vcc3v3>;
			bus-width = <4>;
			non-removable;
			status = "okay";

			emmc@0 {
				reg = <0>;
				compatible = "mmc-card";
				broken-hpi;
			};
		};
	};
};
