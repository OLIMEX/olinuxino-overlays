/dts-v1/;
/plugin/;

/ {
	compatible = "olimex,a20-olinuxino-micro",
		     "olimex,a20-olinuxino-micro-emmc";
	description = "Goodix GT911 CTS controller on I2C2 bus";

	fragment0 {
		target = <&i2c2>;
		__overlay__ {
			gt911@14 {
				compatible = "goodix,gt911";
				reg = <0x14>;

				interrupt-parent = <&pio>;
				interrupts = <7 12 2>;		/* PH12: IRQ_TYPE_EDGE_FALLING */

				irq-gpios = <&pio 7 12 0>;	/* PH12 */
				reset-gpios = <&pio 1 13 0>;	/* PB13: GPIO_ACTIVE_HIGH */

				//touchscreen-swapped-x-y;
			};
		};
	};
};
